## conf/layer.conf
```bitbake
# SPDX-FileCopyrightText: Copyright (c) 2026 Jason Perlow
# SPDX-License-Identifier: Apache-2.0
#
# meta-cix -- Yocto BSP layer for nclawzero on Cix Sky1 / Minisforum MS-R1.

BBPATH .= ":${LAYERDIR}"

BBFILES += " \
    ${LAYERDIR}/recipes-*/*/*.bb \
    ${LAYERDIR}/recipes-*/*/*.bbappend \
"

BBFILE_COLLECTIONS += "cix"
BBFILE_PATTERN_cix = "^${LAYERDIR}/"
BBFILE_PRIORITY_cix = "10"

LAYERDEPENDS_cix = " \
    core \
    meta-poky \
"

LAYERSERIES_COMPAT_cix = "scarthgap"
```
